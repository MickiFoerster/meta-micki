## conf/distro/dns-resolver.conf
```bitbake
MAINTAINER = "micki <micki.foerster@gmail.com>"

require conf/distro/poky.conf

DISTRO = "dns-resolver"
DISTRO_NAME = "DNS Resolver"
DISTRO_VERSION = "1.0"
DISTRO_CODENAME = "kawasaki"
SDK_VENDOR = "-dns-resolver"
SDK_VERSION = "sdkversion"
```

## conf/layer.conf
```bitbake
# We have a conf and classes directory, add to BBPATH
BBPATH .= ":${LAYERDIR}"

# We have recipes-* directories, add to BBFILES
BBFILES += "${LAYERDIR}/recipes-*/*/*.bb \
            ${LAYERDIR}/recipes-*/*/*.bbappend"

BBFILE_COLLECTIONS += "meta-micki"
BBFILE_PATTERN_meta-micki = "^${LAYERDIR}/"
BBFILE_PRIORITY_meta-micki = "6"

LAYERDEPENDS_meta-micki = "core"
LAYERSERIES_COMPAT_meta-micki = "warrior"
```
